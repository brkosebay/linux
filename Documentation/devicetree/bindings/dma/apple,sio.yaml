## drivers/nvme/host/Kconfig
```kconfig
# SPDX-License-Identifier: GPL-2.0-only
config NVME_CORE
	tristate

config BLK_DEV_NVME
	tristate "NVM Express block device"
	depends on PCI && BLOCK
	select NVME_CORE
	help
	  The NVM Express driver is for solid state drives directly
	  connected to the PCI or PCI Express bus.  If you know you
	  don't have one of these, it is safe to answer N.

	  To compile this driver as a module, choose M here: the
	  module will be called nvme.

config NVME_APPLE_ANS_EARLY_USB
	bool "Defer j71t PCIe/ANS probe until early USB userspace is ready"
	depends on BLK_DEV_NVME && PCIE_APPLE_H9P
	help
	  Default pcie_apple_h9p.probe and nvme.apple_ans_probe to false on
	  j71t. The boot initramfs must bring up USB logging/rescue access,
	  set both parameters to true and reprobe the platform PCIe host,
	  then any deferred ANS endpoint. This allows /init to run even when
	  the PCIe link fails before endpoint enumeration. Other boards are
	  unchanged. Requires such an initramfs.

config NVME_PCI_READ_ONLY
	bool "Refuse writes to NVMe PCI devices"
	depends on BLK_DEV_NVME
	default y if ARCH_APPLE
	help
	  Make every NVMe PCI controller read-only. Namespaces are always
	  marked read-only and the driver refuses, before submission, every
	  command that could modify the medium or the controller's persistent
	  state: I/O queues may only read and flush, and the admin queue only
	  accepts identify, log/feature reads, queue management and a short
	  list of volatile Set Features. There is no runtime override.

	  This exists for bring-up on Apple A9/A10 iDevices, whose internal
	  NVMe disk holds the iOS installation. Say N on any other system.

config NVME_PCI_WRITE_WINDOW
	bool "Allow one boot-time write window on read-only NVMe PCI devices"
	depends on NVME_PCI_READ_ONLY
	help
	  Accept nvme.write_window=NSID:FIRST-LAST on the kernel command
	  line. NVMe Write commands to namespace NSID whose whole LBA range
	  lies within FIRST..LAST (inclusive, in that namespace's logical
	  blocks) are then allowed, and that namespace is no longer marked
	  read-only. Everything else CONFIG_NVME_PCI_READ_ONLY refuses stays
	  refused: writes outside the window or to any other namespace,
	  Write Zeroes, Dataset Management (trim), Format, Sanitize, firmware
	  and namespace management, and vendor commands. Trim and Write
	  Zeroes aren't advertised to the block layer while a window is set.

	  Without the parameter, or if it doesn't parse, the controller is
	  exactly as read-only as with CONFIG_NVME_PCI_READ_ONLY alone.

	  This lets an Apple iDevice keep iOS on its disk and run Linux from
	  one partition next to it. Say N unless you need that.

config NVME_MULTIPATH
	bool "NVMe multipath support"
	depends on NVME_CORE
	help
	  This option controls support for multipath access to NVMe
	  subsystems. If this option is enabled support for NVMe multipath
	  access is included in the kernel. If this option is disabled support
	  for NVMe multipath access is excluded from the kernel. When this
	  option is disabled each controller/namespace receives its
	  own /dev/nvmeXnY device entry and NVMe multipath access is
	  not supported.

	  If unsure, say Y.

config NVME_VERBOSE_ERRORS
	bool "NVMe verbose error reporting"
	depends on NVME_CORE
	help
	   This option enables verbose reporting for NVMe errors. The
	   error translation table will grow the kernel image size by
	   about 4 KB.

config NVME_HWMON
	bool "NVMe hardware monitoring"
	depends on (NVME_CORE=y && HWMON=y) || (NVME_CORE=m && HWMON)
	help
	  This provides support for NVMe hardware monitoring. If enabled,
	  a hardware monitoring device will be created for each NVMe drive
	  in the system.

config NVME_FABRICS
	select NVME_CORE
	select NVME_KEYRING if NVME_TCP_TLS
	tristate

config NVME_RDMA
	tristate "NVM Express over Fabrics RDMA host driver"
	depends on INFINIBAND && INFINIBAND_ADDR_TRANS && BLOCK
	select NVME_FABRICS
	select SG_POOL
	help
	  This provides support for the NVMe over Fabrics protocol using
	  the RDMA (Infiniband, RoCE, iWarp) transport.  This allows you
	  to use remote block devices exported using the NVMe protocol set.

	  To configure a NVMe over Fabrics controller use the nvme-cli tool
	  from https://github.com/linux-nvme/nvme-cli.

	  If unsure, say N.

config NVME_FC
	tristate "NVM Express over Fabrics FC host driver"
	depends on BLOCK
	depends on HAS_DMA
	select NVME_FABRICS
	select SG_POOL
	help
	  This provides support for the NVMe over Fabrics protocol using
	  the FC transport.  This allows you to use remote block devices
	  exported using the NVMe protocol set.

	  To configure a NVMe over Fabrics controller use the nvme-cli tool
	  from https://github.com/linux-nvme/nvme-cli.

	  If unsure, say N.

config NVME_TCP
	tristate "NVM Express over Fabrics TCP host driver"
	depends on INET
	depends on BLOCK
	select CRC32
	select NET_CRC32C
	select NVME_FABRICS
	help
	  This provides support for the NVMe over Fabrics protocol using
	  the TCP transport.  This allows you to use remote block devices
	  exported using the NVMe protocol set.

	  To configure a NVMe over Fabrics controller use the nvme-cli tool
	  from https://github.com/linux-nvme/nvme-cli.

	  If unsure, say N.

config NVME_TCP_TLS
	bool "NVMe over Fabrics TCP TLS encryption support"
	depends on NVME_TCP
	select NET_HANDSHAKE
	select KEYS
	select TLS
	help
	  Enables TLS encryption for NVMe TCP using the netlink handshake API.

	  The TLS handshake daemon is available at
	  https://github.com/oracle/ktls-utils.

	  If unsure, say N.

config NVME_HOST_AUTH
	bool "NVMe over Fabrics In-Band Authentication in host side"
	depends on NVME_CORE
	select NVME_AUTH
	select NVME_KEYRING
	help
	  This provides support for NVMe over Fabrics In-Band Authentication in
	  host side.

	  If unsure, say N.

config NVME_APPLE
	tristate "Apple ANS2 NVM Express host driver"
	depends on OF && BLOCK
	depends on APPLE_RTKIT && APPLE_SART
	depends on ARCH_APPLE || COMPILE_TEST
	select NVME_CORE
	help
	  This provides support for the NVMe controller embedded in Apple SoCs
	  such as the M1.

	  To compile this driver as a module, choose M here: the
	  module will be called nvme-apple.
```

## drivers/soc/apple/Kconfig
```kconfig
# SPDX-License-Identifier: GPL-2.0-only

if ARCH_APPLE || COMPILE_TEST

menu "Apple SoC drivers"

config APPLE_A9_AOP
	bool "J71t AOP read-only bring-up observer"
	depends on ARCH_APPLE && OF && DEBUG_FS && APPLE_PMGR_PWRSTATE
	select FW_LOADER
	default n
	help
	  Read only five allowlisted AOP wrapper registers after checking all
	  five power domains. Does not attach to genpd, change power, consume
	  FIFOs, request IRQs or write hardware. Also requires the boot parameter
	  apple_a9_aop.debug=1. An optional attach preflight never starts RTKit.
	  ring_scan=1 instead scans linear-mapped System RAM once through debugfs;
	  ring_iio=1 reads a previously reserved inherited ring when IIO=y.
	  All ring modes exclude the active driver and all wrapper access.
	  With debug=1 ring_scan=1, ring_scan_early=1 captures at postcore initcall
	  before device probing. E1 skips protected/unreadable pages and reports
	  bounded coverage; it never reserves or writes the inherited rings.
	  ring_scan_reserved=1 also reads reserved linear-mapped System RAM;
	  no-map pages and MMIO remain excluded.
	  With debug=1, matching ring_pa/ring_pa_size lists capture up to four
	  exact linear-mapped System RAM ranges twice at postcore, 1 s apart.
	  Each range is at most 64 KiB. No source reservation or write occurs.
	  Independent state_probe=1 captures only CPU status and outbox enable at
	  probe after the five-domain PMGR check; debugfs repeats the saved line.
	  It needs neither debug=1 nor ring mode and excludes the active driver.
	  Independent attach_stage=1 freezes four PMGR-guarded mailbox status
	  registers at probe, without consuming data. Stages 2/3 instead select
	  an explicitly unverified one-shot HELLO / reserved-AFK accel experiment
	  in APPLE_A9_AOP_ACTIVE, with all other observer modes and active=0.

config APPLE_A9_AOP_IIO
	bool "J71t AOP accelerometer IIO consumer"
	depends on APPLE_A9_AOP && IIO
	select IIO_BUFFER
	select IIO_TRIGGERED_BUFFER
	default n
	help
	  IIO accelerometer for the AOP accel service. Registered only by the
	  active driver after the firmware delivered a first report.

config APPLE_A9_AOP_ACTIVE
	bool "J71t AOP active driver (firmware boot, RTBuddy, SPU/AFK)"
	depends on APPLE_A9_AOP_IIO && HAS_DMA
	select CRYPTO_LIB_SHA256
	default n
	help
	  Load and start the AOP firmware from /lib/firmware/apple/aop, run
	  the RTBuddy management and SPU/AFK v8 transport, bind the accel
	  service and register its IIO device. Experimental; inert unless the
	  boot parameter apple_a9_aop.active=1 is given. Never resets the AOP;
	  a running AOP needs fingerprinted, reserved ext memory and two ping
	  acks. Also requires apple_a9_aop.attach=1 for the old attach path.
	  Independent attach_stage=2/3 bypasses that proof under accepted crash
	  risk. No cold loader, AON writes or IRQs; stage 3 grants reserved RAM.

config APPLE_MAILBOX
	tristate "Apple SoC mailboxes"
	depends on PM
	depends on ARCH_APPLE || (64BIT && COMPILE_TEST)
	help
	  Apple SoCs have various co-processors required for certain
	  peripherals to work (NVMe, display controller, etc.). This
	  driver adds support for the mailbox controller used to
	  communicate with those.

	  Say Y here if you have an Apple SoC.

config APPLE_J71T_BOOT_WATCHDOG
	bool "Apple j71t opt-in software boot deadline"
	depends on ARM64 && OF && KEXEC_CORE
	depends on ARCH_APPLE || COMPILE_TEST
	help
	  Allow apple_boot_watchdog.timeout=30..600 to panic if early boot
	  does not finish in time. Userspace must write 0 to its timeout
	  parameter after mounting a usable root. Root can explicitly rearm
	  it before a diagnostic shutdown. Disabled by default and
	  ignored in capture kernels. This never resets the SoC directly.

config APPLE_PMGR_MISC
	tristate "Apple SoC PMGR miscellaneous support"
	depends on PM
	help
	  The PMGR block in Apple SoCs provides high-level power state
	  controls for SoC devices. This driver manages miscellaneous
	  power controls. On A9 (S8000/S8003) it runs the SoC and memory in
	  their fast performance state.

	  Say 'y' here if you have a Pro/Max/Ultra or an A9 Apple SoC.

config APPLE_RTKIT
	tristate "Apple RTKit co-processor IPC protocol"
	depends on APPLE_MAILBOX
	depends on ARCH_APPLE || COMPILE_TEST
	help
	  Apple SoCs such as the M1 come with various co-processors running
	  their proprietary RTKit operating system. This option enables support
	  for the protocol library used to communicate with those. It is used
	  by various client drivers.

	  Say 'y' here if you have an Apple SoC.

config APPLE_PMP_T8015_V1
	tristate "Apple T8015 PMP"
	depends on ARCH_APPLE || COMPILE_TEST
	help
	  Apple PMP is a coprocessor with power-management functions. This
	  option enable support for booting its firmware, which is enough
	  to reduce power consumption.

	  Say 'y' here if you have an Apple A11 SoC.

config APPLE_SIO
	tristate "Apple S8000/T8010 SmartIO coprocessor"
	depends on ARM64
	depends on PM
	depends on ARCH_APPLE || COMPILE_TEST
	help
	  Support the SmartIO coprocessor found on Apple T8010 SoCs. SmartIO
	  boots dedicated firmware and exchanges endpoint messages with the
	  application processor. It provides DMA services to peripheral
	  controllers such as SPI.

	  Say Y here if you have an Apple S8000/S8003 or T8010 SoC.

config APPLE_SART
	tristate "Apple SART DMA address filter"
	depends on ARCH_APPLE || COMPILE_TEST
	help
	  Apple SART is a simple DMA address filter used on Apple SoCs such
	  as the M1. It is usually required for the NVMe coprocessor which does
	  not use a proper IOMMU.

	  Say 'y' here if you have an Apple SoC.

config APPLE_TUNABLE
	tristate
	depends on ARCH_APPLE || COMPILE_TEST

config APPLE_A9_DVFS_RO
	tristate "Read-only Apple S8003 CPU DVFS observer"
	depends on ARCH_APPLE && ARM64 && DEBUG_FS && OF
	help
	  Default-off debugfs snapshot of CPU state and PSINFO words.
	  Requires enable=1 and CAP_SYS_RAWIO. No hardware write path.
	  Does not provide temperatures or decode PMIC rail voltages.

endmenu

endif

config APPLE_SEP_A9
	tristate "Apple A9 Secure Enclave mailbox"
	depends on ARCH_APPLE || COMPILE_TEST
	help
	  Mailbox driver for the Secure Enclave on Apple A9 (s8000/s8003).
	  Exposes raw SEP messaging and endpoint OOL buffer setup. Used to
	  bring up sepOS and the biometric (SBIO) endpoint on iPad 5.
```

## drivers/usb/roles/Kconfig
```kconfig
# SPDX-License-Identifier: GPL-2.0

config USB_ROLE_SWITCH
	tristate "USB Role Switch Support"
	help
	  USB Role Switch is a device that can select the USB role - host or
	  device - for a USB port (connector). In most cases dual-role capable
	  USB controller will also represent the switch, but on some platforms
	  multiplexer/demultiplexer switch is used to route the data lines on
	  the USB connector between separate USB host and device controllers.

	  Say Y here if your USB connectors support both device and host roles.
	  To compile the driver as module, choose M here: the module will be
	  called roles.ko.

if USB_ROLE_SWITCH

config USB_ROLES_INTEL_XHCI
	tristate "Intel XHCI USB Role Switch"
	depends on ACPI && X86
	help
	  Driver for the internal USB role switch for switching the USB data
	  lines between the xHCI host controller and the dwc3 gadget controller
	  found on various Intel SoCs.

	  To compile the driver as a module, choose M here: the module will
	  be called intel-xhci-usb-role-switch.

config USB_ROLES_APPLE_S8000
	tristate "Apple S8000 (A9) Lightning port role switch"
	depends on ARCH_APPLE || COMPILE_TEST
	depends on OF && I2C
	select REGMAP
	help
	  Role switch for the Apple A9 USB complex, which pairs a device-only
	  DWC2 with a separate EHCI + OHCI host pair behind one PHY. Device
	  mode stays the default; host mode is entered on request through
	  /sys/class/usb_role and reverts after a timeout unless confirmed.

	  To compile the driver as a module, choose M here: the module will
	  be called apple-s8000-usb-role.

endif # USB_ROLE_SWITCH
```

## sound/soc/apple/Kconfig
```kconfig
# SPDX-License-Identifier: GPL-2.0-only
menu "Apple"

config SND_SOC_APPLE_MCA
	tristate "Apple Silicon MCA driver"
	depends on ARCH_APPLE || COMPILE_TEST
	select SND_DMAENGINE_PCM
	help
	  This option enables an ASoC platform driver for MCA peripherals found
	  on Apple Silicon SoCs.

config SND_SOC_APPLE_S8000_MCA
	tristate "Apple S8000 (A9) MCA driver"
	depends on ARCH_APPLE || COMPILE_TEST
	depends on COMMON_CLK
	select MFD_SYSCON
	select SND_DMAENGINE_PCM
	select SND_SOC_GENERIC_DMAENGINE_PCM
	help
	  ASoC CPU DAI for the "mca-version 4" serializer of the Apple A9
	  (S8000/S8003), including its MCLK output and i2s-switch route.

endmenu
```
