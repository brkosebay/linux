## Documentation/devicetree/bindings/power/supply/apple,j71t-cbtl1610-power.yaml
```yaml
# SPDX-License-Identifier: GPL-2.0-only OR BSD-2-Clause
%YAML 1.2
---
$id: http://devicetree.org/schemas/power/supply/apple,j71t-cbtl1610-power.yaml#
$schema: http://devicetree.org/meta-schemas/core.yaml#

title: Apple J71t CBTL1610 USB source detection

maintainers:
  - Berkay Kösebay <brkosebay@users.noreply.github.com>

description: |
  VBUS presence, Apple USB host allowances and bounded analog charger
  signature detection for the CBTL1610 revision used by J71t. Temporary
  data-pin monitoring restores the saved route after each measurement.

properties:
  compatible:
    const: apple,j71t-cbtl1610-power

  reg:
    maxItems: 1

  usb-controller:
    $ref: /schemas/types.yaml#/definitions/phandle
    description: USB device controller reporting host current allowances.

  apple,usb-role-switch:
    $ref: /schemas/types.yaml#/definitions/phandle
    description: |
      Shared Lightning USB role switch. With this link, analog charger
      classification is disabled to avoid rerouting host data pins, and
      host mode reports no input current allowance.

  apple,pmic:
    $ref: /schemas/types.yaml#/definitions/phandle
    description: D2365 PMIC providing the brick-ID ADC input.

required:
  - compatible
  - reg
  - usb-controller
  - apple,pmic

additionalProperties: false

examples:
  - |
    i2c {
        #address-cells = <1>;
        #size-cells = <0>;
        power-controller@1a {
            compatible = "apple,j71t-cbtl1610-power";
            reg = <0x1a>;
            usb-controller = <&usbdev>;
            apple,pmic = <&pmic>;
        };
    };
```

## Documentation/devicetree/bindings/soc/apple/apple,t6000-pmgr-misc.yaml
```yaml
# SPDX-License-Identifier: (GPL-2.0-only OR BSD-2-Clause)
%YAML 1.2
---
$id: http://devicetree.org/schemas/soc/apple/apple,t6000-pmgr-misc.yaml#
$schema: http://devicetree.org/meta-schemas/core.yaml#

title: Apple SoC PMGR Misc Power States

maintainers:
  - Sasha Finkelstein <k@chaosmail.tech>

description: |
  Certain Apple SoCs include additional PMGR power states that are controlled
  via a different "misc" control block. This includes the fabric and memory
  controller states. On S8000/S8003 it is the combined SoC and memory
  performance state, with the per-state records that follow it, and the
  registers of PMGR's voltage sequencer.

properties:
  compatible:
    enum:
      - apple,s8000-pmgr-misc
      - apple,t6000-pmgr-misc
      - apple,t6020-pmgr-misc

  reg:
    maxItems: 2

  reg-names:
    maxItems: 2

required:
  - compatible
  - reg
  - reg-names

allOf:
  - if:
      properties:
        compatible:
          contains:
            const: apple,s8000-pmgr-misc
    then:
      properties:
        reg-names:
          items:
            - const: soc-ps
            - const: volman
    else:
      properties:
        reg-names:
          items:
            - const: fabric-ps
            - const: dcs-ps

additionalProperties: false

examples:
  - |
    power-management@8e20c000 {
        compatible = "apple,t6000-pmgr-misc";
        reg = <0x8e20c000 0x400>,
              <0x8e20c800 0x400>;
        reg-names = "fabric-ps", "dcs-ps";
    };
```

## Documentation/devicetree/bindings/sound/apple,s8000-mca.yaml
```yaml
# SPDX-License-Identifier: (GPL-2.0-only OR BSD-2-Clause)
%YAML 1.2
---
$id: http://devicetree.org/schemas/sound/apple,s8000-mca.yaml#
$schema: http://devicetree.org/meta-schemas/core.yaml#

title: Apple S8000 (A9) MCA I2S controller

maintainers:
  - linux-a9 <linux-a9@localhost>

description:
  The A9 "mca-version 4" serializer. Besides its register window it owns a
  32-bit MCLK control word (exported as a clock) and programs a route in the
  shared i2s-switch.

allOf:
  - $ref: dai-common.yaml#

properties:
  compatible:
    const: apple,s8000-mca

  reg:
    items:
      - description: MCA registers
      - description: MCLK control word

  reg-names:
    items:
      - const: mca
      - const: mclk

  interrupts:
    maxItems: 1

  power-domains:
    maxItems: 1

  dmas:
    maxItems: 1

  dma-names:
    const: tx

  '#sound-dai-cells':
    const: 0

  '#clock-cells':
    const: 0

  clock-output-names:
    maxItems: 1

  apple,mclk-control:
    $ref: /schemas/types.yaml#/definitions/uint32
    description: Value written to the MCLK word to enable MCLK output.

  apple,mclk-frequency:
    $ref: /schemas/types.yaml#/definitions/uint32

  apple,i2s-switch:
    $ref: /schemas/types.yaml#/definitions/phandle
    description: The i2s-switch syscon.

  apple,i2s-switch-route:
    $ref: /schemas/types.yaml#/definitions/uint32-matrix
    items:
      items:
        - description: register byte offset
        - description: value
    description: i2s-switch registers to set while the port runs.

  apple,pio-fifo-offset:
    $ref: /schemas/types.yaml#/definitions/uint32
    description: Experimental CPU-writable TX FIFO register (no DMA).

  apple,pio-burst:
    $ref: /schemas/types.yaml#/definitions/uint32

required:
  - compatible
  - reg
  - reg-names
  - interrupts
  - '#sound-dai-cells'

unevaluatedProperties: false
```

## Documentation/devicetree/bindings/sound/cirrus,cs42l81.yaml
```yaml
# SPDX-License-Identifier: (GPL-2.0-only OR BSD-2-Clause)
%YAML 1.2
---
$id: http://devicetree.org/schemas/sound/cirrus,cs42l81.yaml#
$schema: http://devicetree.org/meta-schemas/core.yaml#

title: Cirrus Logic CS42L81 audio codec (Apple)

maintainers:
  - Berkay Kösebay <brkosebay@users.noreply.github.com>

description:
  Apple-specific Cirrus Logic codec with integrated speaker drivers, a
  headphone driver and digital microphone inputs, used on the A9 iPad 5.
  Controlled over SPI with a 5-byte paged register protocol. The codec DAI
  has outputs SPKOUT and HPOUT and DMIC inputs DMIC1A and DMIC1B for
  machine routing.

allOf:
  - $ref: dai-common.yaml#
  - $ref: /schemas/spi/spi-peripheral-props.yaml#

properties:
  compatible:
    const: cirrus,cs42l81

  reg:
    maxItems: 1

  clocks:
    maxItems: 1

  clock-names:
    const: mclk

  mute-gpios:
    maxItems: 1
    description: Speaker mute line, asserted while the speakers are muted.

  hs-switch-gpios:
    maxItems: 2
    description:
      The two control lines of the external headset switch (Apple
      function-ext_sw1, function-ext_sw2). Their direction is not known;
      the driver only reads them.

  apple,max-speaker-gain-db-q8:
    $ref: /schemas/types.yaml#/definitions/int32
    description: Maximum speaker gain in 1/256 dB (ADT spkr-gain-db).

  apple,speaker-mode:
    $ref: /schemas/types.yaml#/definitions/uint32
    enum: [1, 2]
    description: Number of speaker outputs in use.

  '#sound-dai-cells':
    const: 0

required:
  - compatible
  - reg
  - '#sound-dai-cells'

unevaluatedProperties: false

examples:
  - |
    #include <dt-bindings/gpio/gpio.h>

    spi {
      #address-cells = <1>;
      #size-cells = <0>;

      audio-codec@0 {
        compatible = "cirrus,cs42l81";
        reg = <0>;
        spi-max-frequency = <1000000>;
        clocks = <&mca0>;
        clock-names = "mclk";
        mute-gpios = <&pinctrl_ap 64 GPIO_ACTIVE_LOW>;
        hs-switch-gpios = <&pinctrl_ap 68 GPIO_ACTIVE_HIGH>,
                          <&pinctrl_ap 66 GPIO_ACTIVE_HIGH>;
        #sound-dai-cells = <0>;
      };
    };
```

## Documentation/devicetree/bindings/usb/apple,s8000-usb-role-switch.yaml
```yaml
# SPDX-License-Identifier: (GPL-2.0-only OR BSD-2-Clause)
%YAML 1.2
---
$id: http://devicetree.org/schemas/usb/apple,s8000-usb-role-switch.yaml#
$schema: http://devicetree.org/meta-schemas/core.yaml#

title: Apple S8000 USB role switch

maintainers:
  - Berkay Kösebay <brkosebay@users.noreply.github.com>

description: |
  The Apple A9 (S8000/S8003) USB complex pairs a device-only DWC2 controller
  with a separate EHCI + OHCI host pair. All three share one AUSB PHY, and
  the USB_CTL register bank selects whether the PHY serves the host pair.
  The switch owns USB_CTL and the host controllers, which are its child
  nodes and exist only while the port is in the host role. Device mode is
  the default. The switch sits in the USB complex node, which owns the
  complex's DMA remap registers.

properties:
  compatible:
    const: apple,s8000-usb-role-switch

  reg:
    items:
      - description: USB_CTL register bank
      - description: USB complex controller glue registers

  reg-names:
    items:
      - const: usb-ctl
      - const: glue

  "#address-cells":
    const: 2

  "#size-cells":
    const: 2

  ranges: true

  dma-ranges: true

  nonposted-mmio:
    $ref: /schemas/types.yaml#/definitions/flag
    description: The host controller registers need non-posted accesses.

  phys:
    maxItems: 1

  phy-names:
    const: usb2-phy

  apple,usb-device:
    $ref: /schemas/types.yaml#/definitions/phandle
    description: The DWC2 device controller that shares the PHY.

  apple,pmic:
    $ref: /schemas/types.yaml#/definitions/phandle
    description:
      PMIC providing the Lightning accessory power LDO and its switch.

  apple,tristar:
    $ref: /schemas/types.yaml#/definitions/phandle-array
    items:
      - items:
          - description: I2C bus of the Tristar port controller
          - description: 7-bit I2C address of the Tristar
    description:
      Tristar port controller with the connector VBUS sink switch.

patternProperties:
  "^usb@[0-9a-f]+$":
    type: object
    description: The EHCI and its OHCI companion.

required:
  - compatible
  - reg
  - reg-names
  - "#address-cells"
  - "#size-cells"
  - ranges
  - phys
  - phy-names
  - apple,usb-device

additionalProperties: false

examples:
  - |
    #include <dt-bindings/interrupt-controller/apple-aic.h>
    #include <dt-bindings/interrupt-controller/irq.h>
    #include <dt-bindings/phy/phy.h>

    bus {
        #address-cells = <2>;
        #size-cells = <2>;

        usb-role-switch@20e0d8000 {
            compatible = "apple,s8000-usb-role-switch";
            reg = <0x2 0x0e0d8000 0x0 0x1000>,
                  <0x2 0x0c000000 0x0 0x30>;
            reg-names = "usb-ctl", "glue";
            #address-cells = <2>;
            #size-cells = <2>;
            ranges;
            dma-ranges;
            nonposted-mmio;
            phys = <&ausbphy0 PHY_TYPE_USB2>;
            phy-names = "usb2-phy";
            apple,usb-device = <&usbdev>;
            apple,pmic = <&pmic>;
            apple,tristar = <&i2c0 0x1a>;

            usb@20c200000 {
                compatible = "apple,s8000-ehci", "generic-ehci";
                reg = <0x2 0x0c200000 0x0 0x10000>;
                interrupts = <AIC_IRQ 215 IRQ_TYPE_LEVEL_HIGH>;
            };

            usb@20c300000 {
                compatible = "apple,s8000-ohci", "generic-ohci";
                reg = <0x2 0x0c300000 0x0 0x10000>;
                interrupts = <AIC_IRQ 216 IRQ_TYPE_LEVEL_HIGH>;
            };
        };
    };
```

## drivers/gpu/Kconfig
```kconfig
# SPDX-License-Identifier: GPL-2.0

config GPU_BUDDY
       bool
       help
         A page based buddy allocator for GPU memory.

config GPU_BUDDY_KUNIT_TEST
       tristate "KUnit tests for GPU buddy allocator" if !KUNIT_ALL_TESTS
       depends on KUNIT
       select GPU_BUDDY
       default KUNIT_ALL_TESTS
       help
         KUnit tests for the GPU buddy allocator.

config APPLE_G5P_DIAG
	tristate "Apple A9/G5P offline firmware diagnostic"
	depends on ARCH_APPLE && OF && PM
	select FW_LOADER
	select CRYPTO_LIB_SHA256
	help
	  Experimental platform driver for the S8003 G5P META firmware.
	  Inert unless a9_gpu_diag.enable=1 is specified. No rendering support.
```

## drivers/gpu/drm/adbe/Kconfig
```kconfig
# SPDX-License-Identifier: GPL-2.0-only
config DRM_APPLE_ADBE
	tristate "DRM support for the Apple A9 display pipe"
	depends on DRM && OF && ARM64 && MMU
	depends on ARCH_APPLE || COMPILE_TEST
	select APERTURE_HELPERS
	select DRM_CLIENT_SELECTION
	select DRM_GEM_DMA_HELPER
	select DRM_KMS_HELPER
	help
	  KMS driver for the A9 (S8000/S8003) disp0 pipe that iBoot leaves
	  running. It adopts the boot mode, takes the framebuffer over from
	  simpledrm, and adds page flips through the pipe's parameter FIFO
	  and vblank interrupts. It never programs timings, clocks, power or
	  the eDP link. Scanout buffers are DMA (CMA) allocations.

	  Built in, it replaces simpledrm during boot. Booting with
	  apple_adbe_drm.enable=0 keeps simpledrm instead.

	  If M is selected, the module is called apple_adbe_drm.
```

## drivers/gpu/drm/apple-g5p/Kconfig
```kconfig
# SPDX-License-Identifier: GPL-2.0-only
config DRM_APPLE_G5P
	bool "Apple A9/G5P render driver"
	depends on DRM=y && ARCH_APPLE && OF && PM && ARM64_16K_PAGES
	select DRM_GEM_SHMEM_HELPER
	select FW_LOADER
	select CRYPTO_LIB_SHA256
	help
	  Render-node driver for the S8003 G5P GPU using the unmodified META
	  firmware from the device. Supports TYPED_V3 jobs, GEM buffers, PRIME,
	  virtual address spaces and syncobj synchronization for the merged
	  Mesa winsys. Register with a9_gpu_drm.enable=1. Built-in only while
	  reset and active-DMA teardown require the platform boot sequence.
```

## drivers/media/platform/apple/vxd/Kconfig
```kconfig
# SPDX-License-Identifier: GPL-2.0
config VIDEO_APPLE_VXD
	tristate "Apple VXD (PowerVR MSVDX) video decoder driver"
	depends on VIDEO_DEV
	depends on ARCH_APPLE || COMPILE_TEST
	select MEDIA_CONTROLLER
	select VIDEOBUF2_DMA_CONTIG
	select V4L2_MEM2MEM_DEV
	select V4L2_H264
	select CRC32
	help
	  Support for the Apple "VXD" video decoder present on pre-M1 Apple
	  SoCs starting with the S5L8940X: an Imagination PowerVR MSVDX core
	  driven by the resident DEVA (MTX) firmware and host-side parsed
	  parameters.  On the S8000/S8003 (A9) it exposes a V4L2 stateless
	  H.264 decoder device.
	  The DEVA firmware image is not included; stage it as
	  /lib/firmware/apple/vxd-deva.bin, carved from the AppleD5500
	  kext in the iPadOS kernelcache.
	  To compile this driver as a module, choose M here: the module
	  will be called apple-vxd.
```

## drivers/mesa/Kconfig
```kconfig
# SPDX-License-Identifier: GPL-2.0-only
config APPLE_MESA_A9
	tristate "Apple A9 Mesa sensor AP-side power and status transport"
	depends on SPI
	depends on REGULATOR
	depends on ARCH_APPLE || COMPILE_TEST
	help
	  Power sequencing and a single SPI status transport for the Mesa
	  fingerprint sensor on Apple A9 (s8000/s8003) iPads.

	  This slice is deliberately inert: it cannot capture frames, upload
	  a sensor patch, provision the sensor or store keys. It is enabled
	  only by the mesa_a9.enable=1 module parameter, and every sensor
	  operation is an explicit debugfs write gated by CAP_SYS_RAWIO.

	  Say M here for Apple A9 iPads. The module will be called mesa-a9.
```
