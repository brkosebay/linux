## Documentation/devicetree/bindings/dma/apple,sio.yaml
```yaml
# SPDX-License-Identifier: (GPL-2.0-only OR BSD-2-Clause)
%YAML 1.2
---
$id: http://devicetree.org/schemas/dma/apple,sio.yaml#
$schema: http://devicetree.org/meta-schemas/core.yaml#

title: Apple S8000/T8010 SmartIO coprocessor and DMA controller

description: |
  The S8000 (A9) and T8010 (A10) SmartIO coprocessor provides DMA channels
  for peripheral controllers. The application processor boots the SmartIO firmware and
  submits DMA commands through the SIO message queues. Clients select the
  firmware endpoint number used by their peripheral.

maintainers:
  - Paul Praschl <praschlpaul@g-p.at>

allOf:
  - $ref: dma-controller.yaml#

properties:
  compatible:
    enum:
      - apple,s8000-sio
      - apple,t8010-sio

  reg:
    items:
      - description: AppleA7IOPV2 coprocessor and message queue registers
      - description: SmartIO DMA shim registers

  reg-names:
    items:
      - const: a7iop
      - const: shim

  interrupts:
    minItems: 4
    maxItems: 4
    description:
      The four interrupt outputs described by the T8010 SIO device tree node.

  power-domains:
    maxItems: 1

  resets:
    maxItems: 1
    description:
      Power-state reset, used if the coprocessor is found already running.

  apple,dma-endpoints:
    $ref: /schemas/types.yaml#/definitions/uint32-array
    maxItems: 130
    items:
      maximum: 0x81
    description:
      Firmware endpoints exposed as DMA channels. Defaults to the SPI, MCA
      and UART transmit and receive endpoints.

  firmware-name:
    maxItems: 1

  dma-channels:
    const: 64

  '#dma-cells':
    const: 1
    description:
      Clients specify the SmartIO DMA endpoint number, for example 0x1a for
      SPI3 transmit, 0x1b for SPI3 receive or 0x28 for MCA0 transmit.

required:
  - compatible
  - reg
  - reg-names
  - interrupts
  - power-domains
  - firmware-name
  - dma-channels
  - '#dma-cells'

additionalProperties: false

examples:
  - |
    #include <dt-bindings/interrupt-controller/apple-aic.h>
    #include <dt-bindings/interrupt-controller/irq.h>

    soc {
      #address-cells = <2>;
      #size-cells = <2>;

      sio: dma-controller@20ae00000 {
        compatible = "apple,t8010-sio";
        reg = <0x2 0x0ae00000 0x0 0x10000>,
              <0x2 0x0a000000 0x0 0x2000>;
        reg-names = "a7iop", "shim";
        interrupts = <AIC_IRQ 211 IRQ_TYPE_LEVEL_HIGH>,
                     <AIC_IRQ 210 IRQ_TYPE_LEVEL_HIGH>,
                     <AIC_IRQ 213 IRQ_TYPE_LEVEL_HIGH>,
                     <AIC_IRQ 212 IRQ_TYPE_LEVEL_HIGH>;
        power-domains = <&ps_sio>;
        firmware-name = "apple/t8010-smartio.bin";
        dma-channels = <64>;
        #dma-cells = <1>;
      };
    };
```

## Documentation/devicetree/bindings/gpio/apple,d2365-pmic-gpio.yaml
```yaml
# SPDX-License-Identifier: (GPL-2.0-only OR BSD-2-Clause)
%YAML 1.2
---
$id: http://devicetree.org/schemas/gpio/apple,d2365-pmic-gpio.yaml#
$schema: http://devicetree.org/meta-schemas/core.yaml#

title: Apple D2365 PMIC GPIO controller

maintainers:
  - Paul Praschl <praschlpaul@g-p.at>

description: |
  The Dialog D2365 PMIC used in Apple A9/A10 devices provides 24 GPIOs. The
  controller is accessed through the regmap exported by the parent Apple I2C
  PMIC device.

properties:
  compatible:
    const: apple,d2365-pmic-gpio

  gpio-controller: true

  "#gpio-cells":
    const: 2

  gpio-reserved-ranges:
    minItems: 1
    maxItems: 12

  apple,enable-hall-irqs:
    type: boolean
    description: |
      Serve the GPIO events of lines 0 and 10 (PMIC events 0x30 and 0x3a,
      the iPad 5 Smart Cover hall sensors) through the interrupt domain of
      the parent PMIC, which must then describe its AP interrupt and be an
      interrupt controller. The line function and edge configuration left by
      the boot firmware are used as they are. Without this property the
      driver never reads the event or writes the interrupt mask registers.

required:
  - compatible
  - gpio-controller
  - "#gpio-cells"

additionalProperties: false

examples:
  - |
    pmic {
        #address-cells = <1>;
        #size-cells = <1>;

        gpio {
            compatible = "apple,d2365-pmic-gpio";
            #gpio-cells = <2>;
            gpio-controller;
        };
    };
...
```

## Documentation/devicetree/bindings/media/apple,s8000-vxd.yaml
```yaml
# SPDX-License-Identifier: (GPL-2.0-only OR BSD-2-Clause)
%YAML 1.2
---
$id: http://devicetree.org/schemas/media/apple,s8000-vxd.yaml#
$schema: http://devicetree.org/meta-schemas/core.yaml#

title: Apple VXD hardware video decoder (Imagination PowerVR MSVDX)

maintainers:
  - Berkay Kosebay <brkosebay@gmail.com>

description: |
  The Apple "VXD" peripheral is a multi-standard hardware video decoder,
  an Imagination PowerVR MSVDX core running the resident DEVA firmware on
  its MTX (META) microcontroller.  Apple has shipped this IP family since
  the S5L8940X (A4); the S8000/S8003 (A9) in the iPad 5 reports
  vxd-version 7.  The block has no IOMMU (DART): it carries its own
  two-level "GART" translation unit, programmed by the host through the
  MTX MMU registers.

  Linux exposes it as a V4L2 stateless H.264 decoder.  The DEVA firmware
  image must be supplied as /lib/firmware/apple/vxd-deva.bin.

properties:
  compatible:
    items:
      - const: apple,s8000-vxd

  reg:
    maxItems: 1

  interrupts:
    maxItems: 1

  power-domains:
    maxItems: 1

required:
  - compatible
  - reg
  - interrupts
  - power-domains

additionalProperties: false

examples:
  - |
    #include <dt-bindings/interrupt-controller/apple-aic.h>

    soc {
      #address-cells = <2>;
      #size-cells = <2>;

      vxd@207f00000 {
        compatible = "apple,s8000-vxd";
        reg = <0x2 0x07f00000 0x0 0x100000>;
        interrupts = <AIC_IRQ 157 IRQ_TYPE_LEVEL_HIGH>;
        power-domains = <&ps_vdec>;
      };
    };
```

## Documentation/devicetree/bindings/pci/apple,t8010-pcie.yaml
```yaml
# SPDX-License-Identifier: (GPL-2.0-only OR BSD-2-Clause)
%YAML 1.2
---
$id: http://devicetree.org/schemas/pci/apple,t8010-pcie.yaml#
$schema: http://devicetree.org/meta-schemas/core.yaml#

title: Apple S8003 and T8010 PCIe host controller

maintainers:
  - Paul Praschl <praschlpaul@g-p.at>

description: |
  Apple A9/S8003 (TSMC) and A10/T8010 devices use the H8P/H9P PCIe root
  complex for internal storage and Wi-Fi. It exposes one ECAM window shared by up to four root
  ports, controller-specific PHY and port register windows, and a local MSI
  block.

  The storage port also contains an NVMMU which translates the proprietary
  Apple ANS FlatDMA format. Unlike a general-purpose IOMMU, this block uses a
  loader-provided, physically contiguous host-memory buffer and a fixed IOVA
  window. The PCIe driver owns that NVMMU state and exposes it only to the ANS
  NVMe glue.

  Each enabled root port is represented by a child node. This allows port
  devices to carry their own reset, clock-request, firmware and other
  device-specific properties.

allOf:
  - $ref: /schemas/pci/pci-host-bridge.yaml#
  - $ref: /schemas/interrupt-controller/msi-controller.yaml#

properties:
  compatible:
    enum:
      - apple,s8003-pcie
      - apple,t8010-pcie

  reg:
    maxItems: 9

  reg-names:
    items:
      - const: config
      - const: rc
      - const: phy
      - const: phy-ip
      - const: port0
      - const: port1
      - const: port2
      - const: port3
      - const: nvmmu

  interrupts:
    description:
      One state interrupt for each root port followed by the storage-port
      NVMMU fault interrupt.
    maxItems: 5

  interrupt-names:
    items:
      - const: port0
      - const: port1
      - const: port2
      - const: port3
      - const: nvmmu

  clocks:
    maxItems: 3

  clock-names:
    items:
      - const: core
      - const: aux
      - const: ref

  power-domains:
    minItems: 3
    maxItems: 7

  power-domain-names:
    minItems: 3
    items:
      - const: core
      - const: aux
      - const: ref
      - const: link0
      - const: link1
      - const: link2
      - const: link3

  apple,tunable-phy:
    $ref: /schemas/types.yaml#/definitions/uint32-matrix
    items:
      items:
        - description: register offset in the "phy" block
        - description: mask
        - description: value
    description:
      PHY tunables (Apple device tree apcie-phy-tunables), applied as
      (reg & ~mask) | (value & mask) after the common init.

  apple,tunable-common:
    $ref: /schemas/types.yaml#/definitions/uint32-matrix
    items:
      items:
        - description: register offset in the "rc" block
        - description: mask
        - description: value
    description:
      Root complex tunables (apcie-common-tunables), applied after the PHY
      tunables.

  apple,nvmmu-invalidate-fifo:
    $ref: /schemas/types.yaml#/definitions/uint32
    enum: [0, 1, 2]
    default: 0
    description:
      NVMMU invalidate workaround (nvme-mmu0 invalidate-fifo-workaround):
      1 waits for the invalidate FIFO in the port 0 block to drain before
      each invalidate, 2 spaces invalidates by a fixed delay.

  apple,lane-cfg:
    $ref: /schemas/types.yaml#/definitions/uint32
    maximum: 15
    default: 0
    description:
      Lane configuration of the root complex, the "lane-cfg" property of the
      Apple device tree apcie node. Programmed into the common control
      register together with the PHY init request.

  devpwr-gpios:
    description:
      Optional device power GPIOs shared by the root ports.
    maxItems: 4

  msi-parent: true

  msi-ranges:
    maxItems: 1

  apple,msi-doorbell:
    $ref: /schemas/types.yaml#/definitions/uint32
    description:
      MSI doorbell address programmed into downstream endpoints.

  apple,nvmmu-iova:
    $ref: /schemas/types.yaml#/definitions/uint32
    description:
      Base device-visible address of the storage-port NVMMU window.

  apple,nvme-hmb:
    $ref: /schemas/types.yaml#/definitions/phandle
    description:
      Phandle of the loader-populated reserved-memory node used as the Apple
      ANS NVMe host-memory buffer.

  interrupt-controller: true

  '#interrupt-cells':
    const: 1

patternProperties:
  '^pci@[0-3],0$':
    type: object
    properties:
      reg:
        maxItems: 1

      reset-gpios:
        maxItems: 1

      clkreq-gpios:
        maxItems: 1

      pwren-gpios:
        maxItems: 1
        description:
          Power enable of the endpoint (e.g. the Wi-Fi chip's REG_ON). A
          port with this is brought up after probe, once the GPIO exists:
          endpoint powered with PERST# asserted, then the link is trained
          and the bus rescanned.

      device-wake-gpios:
        maxItems: 1
        description:
          Host-to-endpoint wake (ADT "function-device_wake"), kept
          deasserted.

      max-link-speed:
        description:
          Target link speed of the root port. Defaults to 3 (8 GT/s) for
          port 0 on T8010, 2 (5 GT/s) for port 0 on S8003 and 1 otherwise.

      apple,tunable-config:
        $ref: /schemas/types.yaml#/definitions/uint32-matrix
        description:
          Port block tunables (apcie-config-tunables), <offset mask value>.

      apple,tunable-rc:
        $ref: /schemas/types.yaml#/definitions/uint32-matrix
        description:
          Root port config space tunables (pcie-rc-tunables),
          <offset mask value>.

      apple,nvme-mode:
        type: boolean
        description:
          The port carries the ANS NVMe endpoint (ADT "nvme-mode"); S8003
          then switches the root complex into NVMe mode before powering the
          port.

    required:
      - reg
      - reset-gpios

    additionalProperties: true

required:
  - compatible
  - reg
  - reg-names
  - interrupts
  - interrupt-names
  - clocks
  - clock-names
  - power-domains
  - power-domain-names
  - bus-range
  - ranges
  - msi-controller
  - msi-parent
  - msi-ranges
  - apple,nvmmu-iova
  - apple,nvme-hmb
  - '#interrupt-cells'

if:
  properties:
    compatible:
      const: apple,t8010-pcie
then:
  patternProperties:
    '^pci@[0-3],0$':
      required:
        - clkreq-gpios

unevaluatedProperties: false

examples:
  - |
    #include <dt-bindings/gpio/gpio.h>
    #include <dt-bindings/interrupt-controller/apple-aic.h>

    / {
        #address-cells = <2>;
        #size-cells = <2>;

        aliases {
            nvme-hmb = &nvme_hmb;
        };

        aic: interrupt-controller {
            interrupt-controller;
            #interrupt-cells = <3>;
        };

        reserved-memory {
            #address-cells = <2>;
            #size-cells = <2>;
            ranges;

            nvme_hmb: nvme-hmb@0 {
                reg = <0x0 0x0 0x0 0x0>; /* To be filled by loader */
                no-map;
            };
        };

        soc {
            #address-cells = <2>;
            #size-cells = <2>;

            pcie0: pcie@610000000 {
                compatible = "apple,t8010-pcie";
                device_type = "pci";

                reg = <0x6 0x10000000 0x0 0x1000000>,
                      <0x6 0x00000000 0x0 0x8000>,
                      <0x6 0x00008000 0x0 0x4000>,
                      <0x6 0x0a000000 0x0 0x40000>,
                      <0x6 0x01000000 0x0 0x4000>,
                      <0x6 0x02000000 0x0 0x4000>,
                      <0x6 0x03000000 0x0 0x4000>,
                      <0x6 0x04000000 0x0 0x4000>,
                      <0x6 0x01004000 0x0 0x4000>;
                reg-names = "config", "rc", "phy", "phy-ip",
                            "port0", "port1", "port2", "port3",
                            "nvmmu";

                interrupt-parent = <&aic>;
                interrupts = <AIC_IRQ 270 IRQ_TYPE_LEVEL_HIGH>,
                             <AIC_IRQ 273 IRQ_TYPE_LEVEL_HIGH>,
                             <AIC_IRQ 276 IRQ_TYPE_LEVEL_HIGH>,
                             <AIC_IRQ 279 IRQ_TYPE_LEVEL_HIGH>,
                             <AIC_IRQ 272 IRQ_TYPE_EDGE_RISING>;
                interrupt-names = "port0", "port1", "port2", "port3",
                                  "nvmmu";

                msi-controller;
                msi-parent = <&pcie0>;
                msi-ranges = <&aic AIC_IRQ 288 IRQ_TYPE_EDGE_RISING 32>;
                apple,msi-doorbell = <0xbffff000>;
                apple,nvmmu-iova = <0xbc000000>;
                apple,nvme-hmb = <&nvme_hmb>;

                #address-cells = <3>;
                #size-cells = <2>;
                #interrupt-cells = <1>;
                interrupt-controller;
                bus-range = <0x00 0x0f>;
                ranges = <0x03000000 0x0 0xc0000000
                          0x7 0xc0000000 0x0 0x40000000>;

                clocks = <&clkref>, <&clkref>, <&clkref>;
                clock-names = "core", "aux", "ref";
                power-domains = <&ps_pcie>, <&ps_pcie_aux>,
                                <&ps_pcie_ref>;
                power-domain-names = "core", "aux", "ref";

                pci@0,0 {
                    device_type = "pci";
                    reg = <0x0 0x0 0x0 0x0 0x0>;
                    reset-gpios = <&pinctrl_ap 12 GPIO_ACTIVE_LOW>;
                    clkreq-gpios = <&pinctrl_ap 16 GPIO_ACTIVE_LOW>;

                    #address-cells = <3>;
                    #size-cells = <2>;
                    ranges;
                };
            };
        };
    };

...
```
